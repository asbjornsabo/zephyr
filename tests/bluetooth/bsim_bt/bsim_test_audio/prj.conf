## prj.conf
```kconfig
CONFIG_TEST=y
CONFIG_BT_TESTING=y
CONFIG_CONSOLE_HANDLER=y
CONFIG_USERSPACE=n
CONFIG_NO_OPTIMIZATIONS=y

CONFIG_BT=y
CONFIG_BT_CENTRAL=y
CONFIG_BT_PERIPHERAL=y
CONFIG_BT_DEVICE_NAME="bsim_test_audio"
CONFIG_BT_L2CAP_TX_BUF_COUNT=20
CONFIG_BT_MAX_CONN=5
CONFIG_BT_MAX_PAIRED=5
CONFIG_BT_GATT_DYNAMIC_DB=y
CONFIG_BT_SMP=y

# Needed for extended advertising
CONFIG_BT_CTLR_ADV_EXT=y
CONFIG_BT_CTLR_SCAN_DATA_LEN_MAX=255
CONFIG_BT_EXT_ADV_LEGACY_SUPPORT=y

CONFIG_BT_AUDIO=y
CONFIG_BT_AUDIO_UNICAST_SERVER=y
CONFIG_BT_AUDIO_UNICAST_CLIENT=y
CONFIG_BT_AUDIO_UNICAST_CLIENT_GROUP_STREAM_COUNT=2
CONFIG_BT_AUDIO_BROADCAST_SOURCE=y
CONFIG_BT_AUDIO_BROADCAST_SINK=y
CONFIG_BT_AUDIO_BROADCAST_SRC_STREAM_COUNT=2
CONFIG_BT_AUDIO_BROADCAST_SNK_STREAM_COUNT=2

# Volume Offset Control Service
CONFIG_BT_VOCS_MAX_INSTANCE_COUNT=2
CONFIG_BT_VOCS_CLIENT_MAX_INSTANCE_COUNT=2

# Audio Input Control Service
CONFIG_BT_AICS_MAX_INSTANCE_COUNT=4
CONFIG_BT_AICS_CLIENT_MAX_INSTANCE_COUNT=4

#Volume Control
CONFIG_BT_VCS=y
CONFIG_BT_VCS_VOCS_INSTANCE_COUNT=2
CONFIG_BT_VCS_AICS_INSTANCE_COUNT=2
CONFIG_BT_VCS_CLIENT=y
CONFIG_BT_VCS_CLIENT_MAX_VOCS_INST=2
CONFIG_BT_VCS_CLIENT_MAX_AICS_INST=2

CONFIG_BT_MICS=y
CONFIG_BT_MICS_AICS_INSTANCE_COUNT=2
CONFIG_BT_MICS_CLIENT=y
CONFIG_BT_MICS_CLIENT_MAX_AICS_INST=2

# Coordinated Set Identification
CONFIG_BT_CSIS=y
CONFIG_BT_CSIS_TEST_SAMPLE_DATA=y
CONFIG_BT_CSIS_CLIENT=y
CONFIG_BT_CSIS_CLIENT_TEST_SAMPLE_DATA=y

# Media control
CONFIG_BT_MCS=y
CONFIG_BT_MCC=y
CONFIG_BT_MCC_OTS=y
CONFIG_BT_MCC_SHELL=y
CONFIG_BT_MCS_TRACK_TITLE_MAX=40
CONFIG_BT_MCS_ICON_URL_MAX=40
CONFIG_BT_MCC_TOTAL_OBJ_CONTENT_MEM=4096
CONFIG_BT_MCS_MAX_OBJ_SIZE=600

# Object Transfer
CONFIG_BT_OTS=y
CONFIG_BT_OTS_SECONDARY_SVC=y
CONFIG_BT_OTS_MAX_OBJ_CNT=0x30
CONFIG_BT_OTS_CLIENT=y

# DEBUGGING
CONFIG_BT_AUDIO_DEBUG=y
CONFIG_BT_DEBUG_LOG=y
CONFIG_BT_DEBUG_VCS=y
CONFIG_BT_DEBUG_VCS_CLIENT=y
CONFIG_BT_DEBUG_AICS=y
CONFIG_BT_DEBUG_AICS_CLIENT=y
CONFIG_BT_DEBUG_VOCS=y
CONFIG_BT_DEBUG_VOCS_CLIENT=y
CONFIG_BT_DEBUG_MICS=y
CONFIG_BT_DEBUG_MICS_CLIENT=y
CONFIG_BT_DEBUG_MCS=y
CONFIG_BT_DEBUG_MCC=y
CONFIG_BT_OTS_LOG_LEVEL_DBG=y
CONFIG_BT_DEBUG_OTS_CLIENT=y
CONFIG_BT_DEBUG_MEDIA_PROXY=y
CONFIG_BT_DEBUG_CSIS=y
CONFIG_BT_DEBUG_CSIS_CLIENT=y
CONFIG_BT_DEBUG_CSIS_CRYPTO=y
CONFIG_BT_AUDIO_DEBUG_UNICAST_CLIENT=y
CONFIG_BT_AUDIO_DEBUG_UNICAST_SERVER=y
CONFIG_BT_AUDIO_DEBUG_STREAM=y
CONFIG_BT_AUDIO_DEBUG_CAPABILITIES=y
# LOGGING
CONFIG_TEST_LOGGING_DEFAULTS=n
CONFIG_LOG_MODE_IMMEDIATE=y
```

## src/main.c
```c
/*
 * Copyright (c) 2020 Nordic Semiconductor ASA
 *
 * SPDX-License-Identifier: Apache-2.0
 */

#include "bstests.h"

extern struct bst_test_list *test_vcs_install(
	struct bst_test_list *tests);
extern struct bst_test_list *test_vcs_client_install(
	struct bst_test_list *tests);
extern struct bst_test_list *test_tbs_install(
	struct bst_test_list *tests);
extern struct bst_test_list *test_ccp_install(
	struct bst_test_list *tests);
extern struct bst_test_list *test_csis_install(
	struct bst_test_list *tests);
extern struct bst_test_list *test_csip_install(
	struct bst_test_list *tests);
extern struct bst_test_list *test_mics_install(
	struct bst_test_list *tests);
extern struct bst_test_list *test_mics_client_install(struct bst_test_list *tests);
extern struct bst_test_list *test_mcs_install(
	struct bst_test_list *tests);
extern struct bst_test_list *test_mcc_install(
	struct bst_test_list *tests);

bst_test_install_t test_installers[] = {
	test_vcs_install,
	test_vcs_client_install,
	test_tbs_install,
	test_ccp_install,
	test_csis_install,
	test_csip_install,
	test_mics_install,
	test_mics_client_install,
	test_mcs_install,
	test_mcc_install,
	NULL
};

void main(void)
{
	bst_main();
}
```

## src/common.c
```c
/*
 * Copyright (c) 2019 Bose Corporation
 *
 * SPDX-License-Identifier: Apache-2.0
 */

#ifdef CONFIG_BT_TBS
#include "../../../../../subsys/bluetooth/host/audio/tbs.h"
#include "../../../../../subsys/bluetooth/host/audio/ccp.h"
#include "common.h"

extern enum bst_result_t bst_result;
struct bt_conn *default_conn;

const struct bt_data ad[AD_SIZE] = {
	BT_DATA_BYTES(BT_DATA_FLAGS, (BT_LE_AD_GENERAL | BT_LE_AD_NO_BREDR))
};

void device_found(const bt_addr_le_t *addr, int8_t rssi, uint8_t type,
			 struct net_buf_simple *ad)
{
	char addr_str[BT_ADDR_LE_STR_LEN];
	int err;

	if (default_conn) {
		return;
	}

	/* We're only interested in connectable events */
	if (type != BT_HCI_ADV_IND && type != BT_HCI_ADV_DIRECT_IND) {
		return;
	}

	bt_addr_le_to_str(addr, addr_str, sizeof(addr_str));
	printk("Device found: %s (RSSI %d)\n", addr_str, rssi);

	/* connect only to devices in close proximity */
	if (rssi < -70) {
		FAIL("RSSI too low");
		return;
	}

	printk("Stopping scan\n");
	if (bt_le_scan_stop()) {
		FAIL("Could not stop scan");
		return;
	}

	err = bt_conn_le_create(addr, BT_CONN_LE_CREATE_CONN,
				BT_LE_CONN_PARAM_DEFAULT, &default_conn);
	if (err) {
		FAIL("Could not connect to peer: %d", err);
	}
}

void disconnected(struct bt_conn *conn, uint8_t reason)
{
	char addr[BT_ADDR_LE_STR_LEN];

	if (conn != default_conn) {
		return;
	}

	bt_addr_le_to_str(bt_conn_get_dst(conn), addr, sizeof(addr));

	printk("Disconnected: %s (reason %u)\n", addr, reason);

	bt_conn_unref(default_conn);
	default_conn = NULL;
}

struct bt_conn_cb conn_callbacks = {
	.disconnected = disconnected,
};

void test_tick(bs_time_t HW_device_time)
{
	if (bst_result != Passed) {
		FAIL("test failed (not passed after %i seconds)\n", WAIT_TIME);
	}
}

void test_init(void)
{
	bst_ticker_set_next_tick_absolute(WAIT_TIME);
	bst_result = In_progress;
}

#endif /* CONFIG_BT_TBS */
```

## src/common.h
```c
/**
 * Common functions and helpers for BSIM audio tests
 *
 * Copyright (c) 2019 Bose Corporation
 *
 * SPDX-License-Identifier: Apache-2.0
 */

#ifndef ZEPHYR_TEST_BSIM_BT_AUDIO_TEST_
#define ZEPHYR_TEST_BSIM_BT_AUDIO_TEST_

#include "kernel.h"

#include "bs_types.h"
#include "bs_tracing.h"
#include "time_machine.h"
#include "bstests.h"

#include <zephyr/types.h>
#include <stddef.h>
#include <errno.h>
#include <zephyr.h>

#include <bluetooth/bluetooth.h>
#include <bluetooth/hci.h>
#include <bluetooth/conn.h>
#include <bluetooth/uuid.h>
#include <bluetooth/gatt.h>

#define WAIT_TIME (30 * 1e6) /*seconds*/

#define WAIT_FOR(cond) while (!(cond)) { k_sleep(K_MSEC(1)); }

#define CREATE_FLAG(flag) static atomic_t flag = (atomic_t)false
#define SET_FLAG(flag) (void)atomic_set(&flag, (atomic_t)true)
#define UNSET_FLAG(flag) (void)atomic_set(&flag, (atomic_t)false)
#define WAIT_FOR_FLAG(flag)	while (!(bool)atomic_get(&flag)) {   \
					(void)k_sleep(K_MSEC(1)); \
				}

#define FAIL(...)							\
	do {								\
		bst_result = Failed;					\
		bs_trace_error_time_line(__VA_ARGS__);			\
	} while (0)

#define PASS(...)							\
	do {								\
		passes++;						\
		printk("Passes %u/%u\n", passes, expected_passes);	\
		if (passes == expected_passes) {			\
			bst_result = Passed;				\
		}							\
		bs_trace_info_time(1, __VA_ARGS__);			\
	} while (0)

#define SET_STEP(s)							\
	do {								\
		if (s == step + 1) {					\
			step = s;					\
			printk("Step %u\n", step);			\
		} else {						\
			FAIL("Invalid step %u (expected %u)", s, step + 1); \
		}							\
	} while (0)

#define AD_SIZE 1
extern const struct bt_data ad[AD_SIZE];

void device_found(const bt_addr_le_t *addr, int8_t rssi, uint8_t type,
		  struct net_buf_simple *ad);
void disconnected(struct bt_conn *conn, uint8_t reason);
void test_tick(bs_time_t HW_device_time);
void test_init(void);

#endif /* ZEPHYR_TEST_BSIM_BT_AUDIO_TEST_ */
```

## src/mcs_test.c
```c
/*
 * Copyright (c) 2019 Nordic Semiconductor ASA
 *
 * SPDX-License-Identifier: Apache-2.0
 */

#include <zephyr.h>
#include <sys/printk.h>
#include <zephyr/types.h>
#include <stddef.h>
#include <errno.h>
#include <sys/byteorder.h>

#include <bluetooth/bluetooth.h>
#include <bluetooth/hci.h>
#include <bluetooth/conn.h>
#include <bluetooth/uuid.h>
#include <bluetooth/gatt.h>

#include "../../../../subsys/bluetooth/host/audio/mpl.h"

#include "common.h"

extern enum bst_result_t bst_result;
static uint8_t expected_passes = 1;
static uint8_t passes;

static struct bt_conn *default_conn;

CREATE_FLAG(ble_link_is_ready);

/* Callback after Bluetoot initialization attempt */
static void bt_ready(int err)
{
	if (err) {
		FAIL("Bluetooth init failed (err %d)\n", err);
		return;
	}

	printk("Bluetooth initialized\n");

	err = bt_le_adv_start(BT_LE_ADV_CONN_NAME, ad, AD_SIZE, NULL, 0);
	if (err) {
		FAIL("Advertising failed to start (err %d)\n", err);
		return;
	}

	printk("Advertising successfully started\n");
}

/* Callback when connected */
static void connected(struct bt_conn *conn, uint8_t err)
{
	char addr[BT_ADDR_LE_STR_LEN];

	bt_addr_le_to_str(bt_conn_get_dst(conn), addr, sizeof(addr));

	if (err) {
		FAIL("Failed to connect to %s (%u)\n", addr, err);
	} else {
		default_conn = conn;
		printk("Connected: %s\n", addr);
		SET_FLAG(ble_link_is_ready);
	}
}

static void test_main(void)
{
	int err;
	static struct bt_conn_cb conn_callbacks = {
		.connected = connected,
		.disconnected = disconnected,
	};

	printk("Media Control Server test application.  Board: %s\n", CONFIG_BOARD);

	bt_conn_cb_register(&conn_callbacks);

	err = bt_enable(bt_ready);
	if (err) {
		FAIL("Bluetooth init failed (err %d)\n", err);
		return;
	}

	WAIT_FOR_FLAG(ble_link_is_ready);

	PASS("MCS passed\n");
}

static const struct bst_test_instance test_mcs[] = {
	{
		.test_id = "mcs",
		.test_post_init_f = test_init,
		.test_tick_f = test_tick,
		.test_main_f = test_main
	},
	BSTEST_END_MARKER
};

struct bst_test_list *test_mcs_install(struct bst_test_list *tests)
{
	return bst_add_tests(tests, test_mcs);
}
```

## src/mics_client_test.c
```c
/*
 * Copyright (c) 2021 Nordic Semiconductor ASA
 *
 * SPDX-License-Identifier: Apache-2.0
 */

#ifdef CONFIG_BT_MICS_CLIENT

#include <bluetooth/bluetooth.h>
#include <bluetooth/services/mics.h>

#include "common.h"


#define VOCS_DESC_SIZE 64
#define AICS_DESC_SIZE 64

static struct bt_conn_cb conn_callbacks;
extern enum bst_result_t bst_result;
static uint8_t expected_passes = 1;
static uint8_t passes;

static struct bt_mics mics;
static volatile bool g_bt_init;
static volatile bool g_is_connected;
static volatile bool g_mtu_exchanged;
static volatile bool g_discovery_complete;
static volatile bool g_write_complete;

static volatile uint8_t g_mute;
static volatile uint8_t g_aics_count;
static volatile int8_t g_aics_gain;
static volatile uint8_t g_aics_input_mute;
static volatile uint8_t g_aics_mode;
static volatile uint8_t g_aics_input_type;
static volatile uint8_t g_aics_units;
static volatile uint8_t g_aics_gain_max;
static volatile uint8_t g_aics_gain_min;
static volatile bool g_aics_active = 1;
static char g_aics_desc[AICS_DESC_SIZE];
static volatile bool g_cb;
static struct bt_conn *g_conn;

static void aics_state_cb(struct bt_conn *conn, struct bt_aics *inst, int err,
			  int8_t gain, uint8_t mute, uint8_t mode)
{
	if (err) {
		FAIL("AICS state cb err (%d)", err);
		return;
	}

	g_aics_gain = gain;
	g_aics_input_mute = mute;
	g_aics_mode = mode;

	g_cb = true;
}

static void aics_gain_setting_cb(struct bt_conn *conn, struct bt_aics *inst, int err, uint8_t units,
				 int8_t minimum, int8_t maximum)
{
	if (err) {
		FAIL("AICS gain setting cb err (%d)", err);
		return;
	}

	g_aics_units = units;
	g_aics_gain_min = minimum;
	g_aics_gain_max = maximum;

	g_cb = true;
}

static void aics_input_type_cb(struct bt_conn *conn, struct bt_aics *inst, int err,
			       uint8_t input_type)
{
	if (err) {
		FAIL("AICS input type cb err (%d)", err);
		return;
	}

	g_aics_input_type = input_type;

	g_cb = true;
}

static void aics_status_cb(struct bt_conn *conn, struct bt_aics *inst, int err, bool active)
{
	if (err) {
		FAIL("AICS status cb err (%d)", err);
		return;
	}

	g_aics_active = active;

	g_cb = true;
}

static void aics_description_cb(struct bt_conn *conn, struct bt_aics *inst, int err,
				char *description)
{
	if (err) {
		FAIL("AICS description cb err (%d)", err);
		return;
	}

	if (strlen(description) > sizeof(g_aics_desc) - 1) {
		printk("Warning: AICS description (%zu) is larger than buffer (%zu)\n",
		       strlen(description), sizeof(g_aics_desc) - 1);
	}

	strncpy(g_aics_desc, description, sizeof(g_aics_desc) - 1);
	g_aics_desc[sizeof(g_aics_desc) - 1] = '\0';

	g_cb = true;
}

static void aics_write_cb(struct bt_conn *conn, struct bt_aics *inst, int err)
{
	if (err) {
		FAIL("AICS write failed (%d)\n", err);
		return;
	}

	g_write_complete = true;
}

static void mics_discover_cb(struct bt_conn *conn, int err, uint8_t aics_count)
{
	if (err) {
		FAIL("MICS could not be discovered (%d)\n", err);
		return;
	}

	g_aics_count = aics_count;
	g_discovery_complete = true;
}

static void mics_write_cb(struct bt_conn *conn, int err, uint8_t req_val)
{
	if (err) {
		FAIL("MICS write failed for %u (%d)\n", err, req_val);
		return;
	}

	g_write_complete = true;
}

static void mics_mute_cb(struct bt_conn *conn, int err, uint8_t mute)
{
	if (err) {
		FAIL("MICS mute read failed (%d)\n", err);
		return;
	}

	g_mute = mute;
	g_cb = true;
}

static struct bt_mics_cb_t mics_cbs = {
	.discover = mics_discover_cb,
	.mute = mics_mute_cb,
	.mute_write = mics_write_cb,
	.aics_cb  = {
		.state = aics_state_cb,
		.gain_setting = aics_gain_setting_cb,
		.type = aics_input_type_cb,
		.status = aics_status_cb,
		.description = aics_description_cb,
		.set_gain = aics_write_cb,
		.unmute = aics_write_cb,
		.mute = aics_write_cb,
		.set_manual_mode = aics_write_cb,
		.set_auto_mode = aics_write_cb,
	}
};

static void mtu_cb(struct bt_conn *conn, uint8_t err, struct bt_gatt_exchange_params *params)
{
	if (err) {
		FAIL("Failed to exchange MTU (%u)\n", err);
		return;
	}

	g_mtu_exchanged = true;
}

static void connected(struct bt_conn *conn, uint8_t err)
{
	char addr[BT_ADDR_LE_STR_LEN];

	bt_addr_le_to_str(bt_conn_get_dst(conn), addr, sizeof(addr));

	if (err) {
		FAIL("Failed to connect to %s (%u)\n", addr, err);
		return;
	}
	printk("Connected to %s\n", addr);
	g_conn = conn;
	g_is_connected = true;
}

static void bt_ready(int err)
{
	if (err) {
		FAIL("Bluetooth discover failed (err %d)\n", err);
		return;
	}

	g_bt_init = true;
}

static struct bt_conn_cb conn_callbacks = {
	.connected = connected,
	.disconnected = disconnected,
};

static int test_aics(void)
{
	int err;
	int8_t expected_gain;
	uint8_t expected_input_mute;
	uint8_t expected_mode;
	uint8_t expected_input_type;
	char expected_aics_desc[AICS_DESC_SIZE];

	printk("Getting AICS state\n");
	g_cb = false;
	err = bt_mics_aics_state_get(g_conn, mics.aics[0]);
	if (err) {
		FAIL("Could not get AICS state (err %d)\n", err);
		return err;
	}
	WAIT_FOR(g_cb);
	printk("AICS state get\n");

	printk("Getting AICS gain setting\n");
	g_cb = false;
	err = bt_mics_aics_gain_setting_get(g_conn, mics.aics[0]);
	if (err) {
		FAIL("Could not get AICS gain setting (err %d)\n", err);
		return err;
	}
	WAIT_FOR(g_cb);
	printk("AICS gain setting get\n");

	printk("Getting AICS input type\n");
	expected_input_type = BT_AICS_INPUT_TYPE_DIGITAL;
	g_cb = false;
	err = bt_mics_aics_type_get(g_conn, mics.aics[0]);
	if (err) {
		FAIL("Could not get AICS input type (err %d)\n", err);
		return err;
	}
	/* Expect and wait for input_type from init */
	WAIT_FOR(g_cb && expected_input_type == g_aics_input_type);
	printk("AICS input type get\n");

	printk("Getting AICS status\n");
	g_cb = false;
	err = bt_mics_aics_status_get(g_conn, mics.aics[0]);
	if (err) {
		FAIL("Could not get AICS status (err %d)\n", err);
		return err;
	}
	WAIT_FOR(g_cb);
	printk("AICS status get\n");

	printk("Getting AICS description\n");
	g_cb = false;
	err = bt_mics_aics_description_get(g_conn, mics.aics[0]);
	if (err) {
		FAIL("Could not get AICS description (err %d)\n", err);
		return err;
	}
	WAIT_FOR(g_cb);
	printk("AICS description get\n");

	printk("Setting AICS mute\n");
	expected_input_mute = BT_AICS_STATE_MUTED;
	g_write_complete = g_cb = false;
	err = bt_mics_aics_mute(g_conn, mics.aics[0]);
	if (err) {
		FAIL("Could not set AICS mute (err %d)\n", err);
		return err;
	}
	WAIT_FOR(g_aics_input_mute == expected_input_mute &&
		 g_cb && g_write_complete);
	printk("AICS mute set\n");

	printk("Setting AICS unmute\n");
	expected_input_mute = BT_AICS_STATE_UNMUTED;
	g_write_complete = g_cb = false;
	err = bt_mics_aics_unmute(g_conn, mics.aics[0]);
	if (err) {
		FAIL("Could not set AICS unmute (err %d)\n", err);
		return err;
	}
	WAIT_FOR(g_aics_input_mute == expected_input_mute &&
		 g_cb && g_write_complete);
	printk("AICS unmute set\n");

	printk("Setting AICS auto mode\n");
	expected_mode = BT_AICS_MODE_AUTO;
	g_write_complete = g_cb = false;
	err = bt_mics_aics_automatic_gain_set(g_conn, mics.aics[0]);
	if (err) {
		FAIL("Could not set AICS auto mode (err %d)\n", err);
		return err;
	}
	WAIT_FOR(g_aics_mode == expected_mode && g_cb && g_write_complete);
	printk("AICS auto mode set\n");

	printk("Setting AICS manual mode\n");
	expected_mode = BT_AICS_MODE_MANUAL;
	g_write_complete = g_cb = false;
	err = bt_mics_aics_manual_gain_set(g_conn, mics.aics[0]);
	if (err) {
		FAIL("Could not set AICS manual mode (err %d)\n", err);
		return err;
	}
	WAIT_FOR(g_aics_mode == expected_mode && g_cb && g_write_complete);
	printk("AICS manual mode set\n");

	printk("Setting AICS gain\n");
	expected_gain = g_aics_gain_max - 1;
	g_write_complete = g_cb = false;
	err = bt_mics_aics_gain_set(g_conn, mics.aics[0], expected_gain);
	if (err) {
		FAIL("Could not set AICS gain (err %d)\n", err);
		return err;
	}
	WAIT_FOR(g_aics_gain == expected_gain && g_cb && g_write_complete);
	printk("AICS gain set\n");

	printk("Setting AICS Description\n");
	strncpy(expected_aics_desc, "New Input Description",
		sizeof(expected_aics_desc));
	expected_aics_desc[sizeof(expected_aics_desc) - 1] = '\0';
	g_cb = false;
	err = bt_mics_aics_description_set(g_conn, mics.aics[0],
					   expected_aics_desc);
	if (err) {
		FAIL("Could not set AICS Description (err %d)\n", err);
		return err;
	}
	WAIT_FOR(!strncmp(expected_aics_desc, g_aics_desc,
			  sizeof(expected_aics_desc)) &&
		 g_cb);
	printk("AICS Description set\n");

	printk("AICS passed\n");
	return 0;
}

static void test_main(void)
{
	int err;
	uint8_t expected_mute;
	static struct bt_gatt_exchange_params mtu_params = { .func = mtu_cb, };

	err = bt_enable(bt_ready);

	if (err) {
		FAIL("Bluetooth discover failed (err %d)\n", err);
		return;
	}

	bt_conn_cb_register(&conn_callbacks);
	bt_mics_client_cb_register(&mics_cbs);

	WAIT_FOR(g_bt_init);

	err = bt_le_scan_start(BT_LE_SCAN_PASSIVE, device_found);
	if (err) {
		FAIL("Scanning failed to start (err %d)\n", err);
		return;
	}

	printk("Scanning successfully started\n");

	WAIT_FOR(g_is_connected);

	err = bt_gatt_exchange_mtu(g_conn, &mtu_params);
	if (err) {
		FAIL("Failed to exchange MTU %d", err);
	}

	WAIT_FOR(g_mtu_exchanged);

	err = bt_mics_discover(g_conn);
	if (err) {
		FAIL("Failed to discover MICS %d", err);
	}

	WAIT_FOR(g_discovery_complete);

	err = bt_mics_get(g_conn, &mics);
	if (err) {
		FAIL("Failed to get MICS context (err %d)\n", err);
		return;
	}

	printk("Getting MICS mute state\n");
	g_cb = false;
	err = bt_mics_mute_get(g_conn);
	if (err) {
		FAIL("Could not get MICS mute state (err %d)\n", err);
		return;
	}
	WAIT_FOR(g_cb);
	printk("MICS mute state received\n");

	printk("Muting MICS\n");
	expected_mute = 1;
	g_write_complete = g_cb = false;
	err = bt_mics_mute(g_conn);
	if (err) {
		FAIL("Could not mute MICS (err %d)\n", err);
		return;
	}
	WAIT_FOR(g_mute == expected_mute && g_cb && g_write_complete);
	printk("MICS muted\n");

	printk("Unmuting MICS\n");
	expected_mute = 0;
	g_write_complete = g_cb = false;
	err = bt_mics_unmute(g_conn);
	if (err) {
		FAIL("Could not unmute MICS (err %d)\n", err);
		return;
	}
	WAIT_FOR(g_mute == expected_mute && g_cb && g_write_complete);
	printk("MICS unmuted\n");

	if (CONFIG_BT_MICS_CLIENT_MAX_AICS_INST > 0 && g_aics_count > 0) {
		if (test_aics()) {
			return;
		}
	}

	PASS("MICS client Passed");
}

static const struct bst_test_instance test_mics[] = {
	{
		.test_id = "mics_client",
		.test_post_init_f = test_init,
		.test_tick_f = test_tick,
		.test_main_f = test_main
	},
	BSTEST_END_MARKER
};

struct bst_test_list *test_mics_client_install(struct bst_test_list *tests)
{
	return bst_add_tests(tests, test_mics);
}

#else

struct bst_test_list *test_mics_client_install(struct bst_test_list *tests)
{
	return tests;
}

#endif /* CONFIG_BT_MICS_CLIENT */
```

## src/mics_test.c
```c
/*
 * Copyright (c) 2020 Nordic Semiconductor ASA
 *
 * SPDX-License-Identifier: Apache-2.0
 */

#ifdef CONFIG_BT_MICS
#include "bluetooth/services/mics.h"
#include "common.h"

extern enum bst_result_t bst_result;
static uint8_t expected_passes = 1;
static uint8_t passes;

#if defined(CONFIG_BT_AICS)
#define AICS_DESC_SIZE CONFIG_BT_AICS_MAX_INPUT_DESCRIPTION_SIZE
#else
#define AICS_DESC_SIZE 0
#endif /* CONFIG_BT_AICS */

static struct bt_mics mics;

static volatile uint8_t g_mute;
static volatile int8_t g_aics_gain;
static volatile uint8_t g_aics_input_mute;
static volatile uint8_t g_aics_mode;
static volatile uint8_t g_aics_input_type;
static volatile uint8_t g_aics_units;
static volatile uint8_t g_aics_gain_max;
static volatile uint8_t g_aics_gain_min;
static volatile bool g_aics_active = 1;
static char g_aics_desc[AICS_DESC_SIZE];
static volatile bool g_cb;
static struct bt_conn *g_conn;
static bool g_is_connected;

static void mics_mute_cb(struct bt_conn *conn, int err, uint8_t mute)
{
	if (err) {
		FAIL("MICS mute cb err (%d)", err);
		return;
	}

	g_mute = mute;

	if (!conn) {
		g_cb = true;
	}
}

static void aics_state_cb(struct bt_conn *conn, struct bt_aics *inst, int err,
			  int8_t gain, uint8_t mute, uint8_t mode)
{
	if (err) {
		FAIL("AICS state cb err (%d)", err);
		return;
	}

	g_aics_gain = gain;
	g_aics_input_mute = mute;
	g_aics_mode = mode;

	if (!conn) {
		g_cb = true;
	}
}

static void aics_gain_setting_cb(struct bt_conn *conn, struct bt_aics *inst,
				 int err, uint8_t units, int8_t minimum,
				 int8_t maximum)
{
	if (err) {
		FAIL("AICS gain setting cb err (%d)", err);
		return;
	}

	g_aics_units = units;
	g_aics_gain_min = minimum;
	g_aics_gain_max = maximum;

	if (!conn) {
		g_cb = true;
	}
}

static void aics_input_type_cb(struct bt_conn *conn, struct bt_aics *inst,
			       int err, uint8_t input_type)
{
	if (err) {
		FAIL("AICS input type cb err (%d)", err);
		return;
	}

	g_aics_input_type = input_type;

	if (!conn) {
		g_cb = true;
	}
}

static void aics_status_cb(struct bt_conn *conn, struct bt_aics *inst, int err,
			   bool active)
{
	if (err) {
		FAIL("AICS status cb err (%d)", err);
		return;
	}

	g_aics_active = active;

	if (!conn) {
		g_cb = true;
	}
}

static void aics_description_cb(struct bt_conn *conn, struct bt_aics *inst,
				int err, char *description)
{
	if (err) {
		FAIL("AICS description cb err (%d)", err);
		return;
	}


	strncpy(g_aics_desc, description, sizeof(g_aics_desc) - 1);
	g_aics_desc[sizeof(g_aics_desc) - 1] = '\0';

	if (!conn) {
		g_cb = true;
	}
}

static struct bt_mics_cb_t mics_cb = {
	.mute = mics_mute_cb,
	.aics_cb  = {
		.state = aics_state_cb,
		.gain_setting = aics_gain_setting_cb,
		.type = aics_input_type_cb,
		.status = aics_status_cb,
		.description = aics_description_cb
	}
};


static void connected(struct bt_conn *conn, uint8_t err)
{
	char addr[BT_ADDR_LE_STR_LEN];

	bt_addr_le_to_str(bt_conn_get_dst(conn), addr, sizeof(addr));

	if (err) {
		FAIL("Failed to connect to %s (%u)\n", addr, err);
		return;
	}
	printk("Connected to %s\n", addr);
	g_conn = conn;
	g_is_connected = true;
}

static struct bt_conn_cb conn_callbacks = {
	.connected = connected,
	.disconnected = disconnected,
};

static int test_aics_standalone(void)
{
	int err;
	int8_t expected_gain;
	uint8_t expected_input_mute;
	uint8_t expected_mode;
	uint8_t expected_input_type;
	bool expected_aics_active;
	char expected_aics_desc[AICS_DESC_SIZE];

	printk("Deactivating AICS\n");
	expected_aics_active = false;
	err = bt_mics_aics_deactivate(mics.aics[0]);
	if (err) {
		FAIL("Could not deactivate AICS (err %d)\n", err);
		return err;
	}
	WAIT_FOR(expected_aics_active == g_aics_active);
	printk("AICS deactivated\n");

	printk("Activating AICS\n");
	expected_aics_active = true;
	err = bt_mics_aics_activate(mics.aics[0]);
	if (err) {
		FAIL("Could not activate AICS (err %d)\n", err);
		return err;
	}
	WAIT_FOR(expected_aics_active == g_aics_active);
	printk("AICS activated\n");

	printk("Getting AICS state\n");
	g_cb = false;
	err = bt_mics_aics_state_get(NULL, mics.aics[0]);
	if (err) {
		FAIL("Could not get AICS state (err %d)\n", err);
		return err;
	}
	WAIT_FOR(g_cb);
	printk("AICS state get\n");

	printk("Getting AICS gain setting\n");
	g_cb = false;
	err = bt_mics_aics_gain_setting_get(NULL, mics.aics[0]);
	if (err) {
		FAIL("Could not get AICS gain setting (err %d)\n", err);
		return err;
	}
	WAIT_FOR(g_cb);
	printk("AICS gain setting get\n");

	printk("Getting AICS input type\n");
	expected_input_type = BT_AICS_INPUT_TYPE_DIGITAL;
	err = bt_mics_aics_type_get(NULL, mics.aics[0]);
	if (err) {
		FAIL("Could not get AICS input type (err %d)\n", err);
		return err;
	}
	/* Expect and wait for input_type from init */
	WAIT_FOR(expected_input_type == g_aics_input_type);
	printk("AICS input type get\n");

	printk("Getting AICS status\n");
	g_cb = false;
	err = bt_mics_aics_status_get(NULL, mics.aics[0]);
	if (err) {
		FAIL("Could not get AICS status (err %d)\n", err);
		return err;
	}
	WAIT_FOR(g_cb);
	printk("AICS status get\n");

	printk("Getting AICS description\n");
	g_cb = false;
	err = bt_mics_aics_description_get(NULL, mics.aics[0]);
	if (err) {
		FAIL("Could not get AICS description (err %d)\n", err);
		return err;
	}
	WAIT_FOR(g_cb);
	printk("AICS description get\n");

	printk("Setting AICS mute\n");
	expected_input_mute = BT_AICS_STATE_MUTED;
	err = bt_mics_aics_mute(NULL, mics.aics[0]);
	if (err) {
		FAIL("Could not set AICS mute (err %d)\n", err);
		return err;
	}
	WAIT_FOR(expected_input_mute == g_aics_input_mute);
	printk("AICS mute set\n");

	printk("Setting AICS unmute\n");
	expected_input_mute = BT_AICS_STATE_UNMUTED;
	err = bt_mics_aics_unmute(NULL, mics.aics[0]);
	if (err) {
		FAIL("Could not set AICS unmute (err %d)\n", err);
		return err;
	}
	WAIT_FOR(expected_input_mute == g_aics_input_mute);
	printk("AICS unmute set\n");

	printk("Setting AICS auto mode\n");
	expected_mode = BT_AICS_MODE_AUTO;
	err = bt_mics_aics_automatic_gain_set(NULL, mics.aics[0]);
	if (err) {
		FAIL("Could not set AICS auto mode (err %d)\n", err);
		return err;
	}
	WAIT_FOR(expected_input_mute == g_aics_input_mute);
	printk("AICS auto mode set\n");

	printk("Setting AICS manual mode\n");
	expected_mode = BT_AICS_MODE_MANUAL;
	err = bt_mics_aics_manual_gain_set(NULL, mics.aics[0]);
	if (err) {
		FAIL("Could not set AICS manual mode (err %d)\n", err);
		return err;
	}
	WAIT_FOR(expected_input_mute == g_aics_input_mute);
	printk("AICS manual mode set\n");

	printk("Setting AICS gain\n");
	expected_gain = g_aics_gain_max - 1;
	err = bt_mics_aics_gain_set(NULL, mics.aics[0], expected_gain);
	if (err) {
		FAIL("Could not set AICS gain (err %d)\n", err);
		return err;
	}
	WAIT_FOR(expected_gain == g_aics_gain);
	printk("AICS gain set\n");

	printk("Setting AICS Description\n");
	strncpy(expected_aics_desc, "New Input Description",
		sizeof(expected_aics_desc) - 1);
	expected_aics_desc[sizeof(expected_aics_desc) - 1] = '\0';
	g_cb = false;
	err = bt_mics_aics_description_set(NULL, mics.aics[0],
					   expected_aics_desc);
	if (err) {
		FAIL("Could not set AICS Description (err %d)\n", err);
		return err;
}
	WAIT_FOR(g_cb && !strncmp(expected_aics_desc, g_aics_desc,
				  sizeof(expected_aics_desc)));
	printk("AICS Description set\n");

	return 0;
}

static void test_standalone(void)
{
	int err;
	struct bt_mics_init mics_init;
	char input_desc[CONFIG_BT_MICS_AICS_INSTANCE_COUNT][16];
	uint8_t expected_mute;

	err = bt_enable(NULL);
	if (err) {
		FAIL("Bluetooth init failed (err %d)\n", err);
		return;
	}

	printk("Bluetooth initialized\n");

	memset(&mics_init, 0, sizeof(mics_init));

	for (int i = 0; i < ARRAY_SIZE(mics_init.aics_init); i++) {
		mics_init.aics_init[i].desc_writable = true;
		snprintf(input_desc[i], sizeof(input_desc[i]),
			 "Input %d", i + 1);
		mics_init.aics_init[i].input_desc = input_desc[i];
		mics_init.aics_init[i].input_type = BT_AICS_INPUT_TYPE_DIGITAL;
		mics_init.aics_init[i].input_state = g_aics_active;
		mics_init.aics_init[i].mode = BT_AICS_MODE_MANUAL;
		mics_init.aics_init[i].units = 1;
		mics_init.aics_init[i].min_gain = 0;
		mics_init.aics_init[i].max_gain = 100;
	}

	err = bt_mics_init(&mics_init);
	if (err) {
		FAIL("MICS init failed (err %d)\n", err);
		return;
	}

	bt_mics_server_cb_register(&mics_cb);


	err = bt_mics_get(NULL, &mics);

	printk("MICS initialized\n");

	printk("Getting MICS mute\n");
	g_cb = false;
	err = bt_mics_mute_get(NULL);
	if (err) {
		FAIL("Could not get MICS mute (err %d)\n", err);
		return;
	}
	WAIT_FOR(g_cb);
	printk("MICS mute get\n");

	printk("Setting MICS mute\n");
	expected_mute = BT_MICS_MUTE_MUTED;
	err = bt_mics_mute(NULL);
	if (err) {
		FAIL("MICS mute failed (err %d)\n", err);
		return;
	}
	WAIT_FOR(expected_mute == g_mute);
	printk("MICS mute set\n");

	printk("Setting MICS unmute\n");
	expected_mute = BT_MICS_MUTE_UNMUTED;
	err = bt_mics_unmute(NULL);
	if (err) {
		FAIL("MICS unmute failed (err %d)\n", err);
		return;
	}
	WAIT_FOR(expected_mute == g_mute);
	printk("MICS unmute set\n");

	printk("Setting MICS disable\n");
	expected_mute = BT_MICS_MUTE_DISABLED;
	err = bt_mics_mute_disable();
	if (err) {
		FAIL("MICS disable failed (err %d)\n", err);
		return;
	}
	WAIT_FOR(expected_mute == g_mute);
	printk("MICS disable set\n");

	if (CONFIG_BT_MICS_AICS_INSTANCE_COUNT > 0) {
		if (test_aics_standalone()) {
			return;
		}
	}

	PASS("MICS passed\n");
}

static void test_main(void)
{
	int err;
	struct bt_mics_init mics_init;
	char input_desc[CONFIG_BT_MICS_AICS_INSTANCE_COUNT][16];

	err = bt_enable(NULL);
	if (err) {
		FAIL("Bluetooth init failed (err %d)\n", err);
		return;
	}

	printk("Bluetooth initialized\n");

	memset(&mics_init, 0, sizeof(mics_init));

	for (int i = 0; i < ARRAY_SIZE(mics_init.aics_init); i++) {
		mics_init.aics_init[i].desc_writable = true;
		snprintf(input_desc[i], sizeof(input_desc[i]),
			 "Input %d", i + 1);
		mics_init.aics_init[i].input_desc = input_desc[i];
		mics_init.aics_init[i].input_type = BT_AICS_INPUT_TYPE_DIGITAL;
		mics_init.aics_init[i].input_state = g_aics_active;
		mics_init.aics_init[i].mode = BT_AICS_MODE_MANUAL;
		mics_init.aics_init[i].units = 1;
		mics_init.aics_init[i].min_gain = 0;
		mics_init.aics_init[i].max_gain = 100;
	}

	err = bt_mics_init(&mics_init);
	if (err) {
		FAIL("MICS init failed (err %d)\n", err);
		return;
	}

	bt_mics_server_cb_register(&mics_cb);
	bt_conn_cb_register(&conn_callbacks);

	err = bt_mics_get(NULL, &mics);
	if (err) {
		FAIL("MICS get failed (err %d)\n", err);
		return;
	}

	printk("MICS initialized\n");

	err = bt_le_adv_start(BT_LE_ADV_CONN_NAME, ad, AD_SIZE, NULL, 0);
	if (err) {
		FAIL("Advertising failed to start (err %d)\n", err);
		return;
	}

	printk("Advertising successfully started\n");

	WAIT_FOR(g_is_connected);

	PASS("MICS passed\n");
}

static const struct bst_test_instance test_mics[] = {
	{
		.test_id = "mics_standalone",
		.test_post_init_f = test_init,
		.test_tick_f = test_tick,
		.test_main_f = test_standalone
	},
	{
		.test_id = "mics",
		.test_post_init_f = test_init,
		.test_tick_f = test_tick,
		.test_main_f = test_main
	},
	BSTEST_END_MARKER
};

struct bst_test_list *test_mics_install(struct bst_test_list *tests)
{
	return bst_add_tests(tests, test_mics);
}
#else
struct bst_test_list *test_mics_install(struct bst_test_list *tests)
{
	return tests;
}

#endif /* CONFIG_BT_MICS */
```

## src/vcs_client_test.c
```c
/*
 * Copyright (c) 2021 Nordic Semiconductor ASA
 *
 * SPDX-License-Identifier: Apache-2.0
 */

#ifdef CONFIG_BT_VCS_CLIENT

#include <bluetooth/bluetooth.h>
#include <bluetooth/services/vcs.h>

#include "common.h"


#define VOCS_DESC_SIZE 64
#define AICS_DESC_SIZE 64

static struct bt_conn_cb conn_callbacks;
extern enum bst_result_t bst_result;
static uint8_t expected_passes = 1;
static uint8_t passes;

static struct bt_vcs vcs;
static volatile bool g_bt_init;
static volatile bool g_is_connected;
static volatile bool g_mtu_exchanged;
static volatile bool g_discovery_complete;
static volatile bool g_write_complete;

static volatile uint8_t g_volume;
static volatile uint8_t g_mute;
static volatile uint8_t g_flags;
static volatile int16_t g_vocs_offset;
static volatile uint32_t g_vocs_location;
static char g_vocs_desc[VOCS_DESC_SIZE];
static volatile int8_t g_aics_gain;
static volatile uint8_t g_aics_input_mute;
static volatile uint8_t g_aics_mode;
static volatile uint8_t g_aics_input_type;
static volatile uint8_t g_aics_units;
static volatile uint8_t g_aics_gain_max;
static volatile uint8_t g_aics_gain_min;
static volatile bool g_aics_active = 1;
static char g_aics_desc[AICS_DESC_SIZE];
static volatile bool g_cb;
static struct bt_conn *g_conn;

static void vcs_state_cb(
	struct bt_conn *conn, int err, uint8_t volume, uint8_t mute)
{
	if (err) {
		FAIL("VCS state cb err (%d)", err);
		return;
	}

	g_volume = volume;
	g_mute = mute;

	g_cb = true;
}

static void vcs_flags_cb(struct bt_conn *conn, int err, uint8_t flags)
{
	if (err) {
		FAIL("VCS flags cb err (%d)", err);
		return;
	}

	g_flags = flags;

	g_cb = true;
}

static void vocs_state_cb(struct bt_conn *conn, struct bt_vocs *inst, int err,
			  int16_t offset)
{
	if (err) {
		FAIL("VOCS state cb err (%d)", err);
		return;
	}

	g_vocs_offset = offset;

	g_cb = true;
}

static void vocs_location_cb(struct bt_conn *conn, struct bt_vocs *inst,
			     int err, uint32_t location)
{
	if (err) {
		FAIL("VOCS location cb err (%d)", err);
		return;
	}

	g_vocs_location = location;

	g_cb = true;
}

static void vocs_description_cb(struct bt_conn *conn, struct bt_vocs *inst,
				int err, char *description)
{
	if (err) {
		FAIL("VOCS description cb err (%d)", err);
		return;
	}

	if (strlen(description) > sizeof(g_vocs_desc) - 1) {
		printk("Warning: VOCS description (%zu) is larger "
		       "than buffer (%zu)\n",
		       strlen(description), sizeof(g_vocs_desc) - 1);
	}

	strncpy(g_vocs_desc, description, sizeof(g_vocs_desc) - 1);

	g_cb = true;
}

static void vocs_write_cb(struct bt_conn *conn, struct bt_vocs *inst, int err)
{
	if (err) {
		FAIL("VOCS write failed (%d)\n", err);
		return;
	}

	g_write_complete = true;
}

static void aics_state_cb(struct bt_conn *conn, struct bt_aics *inst, int err,
			  int8_t gain, uint8_t mute, uint8_t mode)
{
	if (err) {
		FAIL("AICS state cb err (%d)", err);
		return;
	}

	g_aics_gain = gain;
	g_aics_input_mute = mute;
	g_aics_mode = mode;

	g_cb = true;
}

static void aics_gain_setting_cb(struct bt_conn *conn, struct bt_aics *inst,
				 int err, uint8_t units, int8_t minimum,
				 int8_t maximum)
{
	if (err) {
		FAIL("AICS gain setting cb err (%d)", err);
		return;
	}

	g_aics_units = units;
	g_aics_gain_min = minimum;
	g_aics_gain_max = maximum;

	g_cb = true;
}

static void aics_input_type_cb(struct bt_conn *conn, struct bt_aics *inst,
			       int err, uint8_t input_type)
{
	if (err) {
		FAIL("AICS input type cb err (%d)", err);
		return;
	}

	g_aics_input_type = input_type;

	g_cb = true;
}

static void aics_status_cb(struct bt_conn *conn, struct bt_aics *inst, int err,
			   bool active)
{
	if (err) {
		FAIL("AICS status cb err (%d)", err);
		return;
	}

	g_aics_active = active;

	g_cb = true;
}

static void aics_description_cb(struct bt_conn *conn, struct bt_aics *inst,
				int err, char *description)
{
	if (err) {
		FAIL("AICS description cb err (%d)", err);
		return;
	}

	if (strlen(description) > sizeof(g_aics_desc) - 1) {
		printk("Warning: AICS description (%zu) is larger "
		       "than buffer (%zu)\n",
		       strlen(description), sizeof(g_aics_desc) - 1);
	}

	strncpy(g_aics_desc, description, sizeof(g_aics_desc) - 1);

	g_cb = true;
}

static void aics_write_cb(struct bt_conn *conn, struct bt_aics *inst, int err)
{
	if (err) {
		FAIL("AICS write failed (%d)\n", err);
		return;
	}

	g_write_complete = true;
}

static void vcs_discover_cb(struct bt_conn *conn, int err, uint8_t vocs_count,
			    uint8_t aics_count)
{
	if (err) {
		FAIL("VCS could not be discovered (%d)\n", err);
		return;
	}

	g_discovery_complete = true;
}

static void vcs_write_cb(struct bt_conn *conn, int err)
{
	if (err) {
		FAIL("VCS write failed (%d)\n", err);
		return;
	}

	g_write_complete = true;
}

static struct bt_vcs_cb_t vcs_cbs = {
	.discover = vcs_discover_cb,
	.vol_down = vcs_write_cb,
	.vol_up = vcs_write_cb,
	.mute = vcs_write_cb,
	.unmute = vcs_write_cb,
	.vol_down_unmute = vcs_write_cb,
	.vol_up_unmute = vcs_write_cb,
	.vol_set = vcs_write_cb,
	.state = vcs_state_cb,
	.flags = vcs_flags_cb,
	.vocs_cb = {
		.state = vocs_state_cb,
		.location = vocs_location_cb,
		.description = vocs_description_cb,
		.set_offset = vocs_write_cb,
	},
	.aics_cb  = {
		.state = aics_state_cb,
		.gain_setting = aics_gain_setting_cb,
		.type = aics_input_type_cb,
		.status = aics_status_cb,
		.description = aics_description_cb,
		.set_gain = aics_write_cb,
		.unmute = aics_write_cb,
		.mute = aics_write_cb,
		.set_manual_mode = aics_write_cb,
		.set_auto_mode = aics_write_cb,
	}
};

static void mtu_cb(struct bt_conn *conn, uint8_t err,
		   struct bt_gatt_exchange_params *params)
{
	if (err) {
		FAIL("Failed to exchange MTU (%u)\n", err);
		return;
	}

	g_mtu_exchanged = true;
}

static void connected(struct bt_conn *conn, uint8_t err)
{
	char addr[BT_ADDR_LE_STR_LEN];

	bt_addr_le_to_str(bt_conn_get_dst(conn), addr, sizeof(addr));

	if (err) {
		FAIL("Failed to connect to %s (%u)\n", addr, err);
		return;
	}
	printk("Connected to %s\n", addr);
	g_conn = conn;
	g_is_connected = true;
}

static void bt_ready(int err)
{
	if (err) {
		FAIL("Bluetooth discover failed (err %d)\n", err);
		return;
	}

	g_bt_init = true;
}

static struct bt_conn_cb conn_callbacks = {
	.connected = connected,
	.disconnected = disconnected,
};

static int test_aics(void)
{
	int err;
	int8_t expected_gain;
	uint8_t expected_input_mute;
	uint8_t expected_mode;
	uint8_t expected_input_type;
	char expected_aics_desc[AICS_DESC_SIZE];

	printk("Getting AICS state\n");
	g_cb = false;
	err = bt_vcs_aics_state_get(g_conn, vcs.aics[0]);
	if (err) {
		FAIL("Could not get AICS state (err %d)\n", err);
		return err;
	}
	WAIT_FOR(g_cb);
	printk("AICS state get\n");

	printk("Getting AICS gain setting\n");
	g_cb = false;
	err = bt_vcs_aics_gain_setting_get(g_conn, vcs.aics[0]);
	if (err) {
		FAIL("Could not get AICS gain setting (err %d)\n", err);
		return err;
	}
	WAIT_FOR(g_cb);
	printk("AICS gain setting get\n");

	printk("Getting AICS input type\n");
	expected_input_type = BT_AICS_INPUT_TYPE_DIGITAL;
	g_cb = false;
	err = bt_vcs_aics_type_get(g_conn, vcs.aics[0]);
	if (err) {
		FAIL("Could not get AICS input type (err %d)\n", err);
		return err;
	}
	/* Expect and wait for input_type from init */
	WAIT_FOR(g_cb && expected_input_type == g_aics_input_type);
	printk("AICS input type get\n");

	printk("Getting AICS status\n");
	g_cb = false;
	err = bt_vcs_aics_status_get(g_conn, vcs.aics[0]);
	if (err) {
		FAIL("Could not get AICS status (err %d)\n", err);
		return err;
	}
	WAIT_FOR(g_cb);
	printk("AICS status get\n");

	printk("Getting AICS description\n");
	g_cb = false;
	err = bt_vcs_aics_description_get(g_conn, vcs.aics[0]);
	if (err) {
		FAIL("Could not get AICS description (err %d)\n", err);
		return err;
	}
	WAIT_FOR(g_cb);
	printk("AICS description get\n");

	printk("Setting AICS mute\n");
	expected_input_mute = BT_AICS_STATE_MUTED;
	g_write_complete = g_cb = false;
	err = bt_vcs_aics_mute(g_conn, vcs.aics[0]);
	if (err) {
		FAIL("Could not set AICS mute (err %d)\n", err);
		return err;
	}
	WAIT_FOR(g_aics_input_mute == expected_input_mute &&
		 g_cb && g_write_complete);
	printk("AICS mute set\n");

	printk("Setting AICS unmute\n");
	expected_input_mute = BT_AICS_STATE_UNMUTED;
	g_write_complete = g_cb = false;
	err = bt_vcs_aics_unmute(g_conn, vcs.aics[0]);
	if (err) {
		FAIL("Could not set AICS unmute (err %d)\n", err);
		return err;
	}
	WAIT_FOR(g_aics_input_mute == expected_input_mute &&
		 g_cb && g_write_complete);
	printk("AICS unmute set\n");

	printk("Setting AICS auto mode\n");
	expected_mode = BT_AICS_MODE_AUTO;
	g_write_complete = g_cb = false;
	err = bt_vcs_aics_automatic_gain_set(g_conn, vcs.aics[0]);
	if (err) {
		FAIL("Could not set AICS auto mode (err %d)\n", err);
		return err;
	}
	WAIT_FOR(g_aics_mode == expected_mode && g_cb && g_write_complete);
	printk("AICS auto mode set\n");

	printk("Setting AICS manual mode\n");
	expected_mode = BT_AICS_MODE_MANUAL;
	g_write_complete = g_cb = false;
	err = bt_vcs_aics_manual_gain_set(g_conn, vcs.aics[0]);
	if (err) {
		FAIL("Could not set AICS manual mode (err %d)\n", err);
		return err;
	}
	WAIT_FOR(g_aics_mode == expected_mode && g_cb && g_write_complete);
	printk("AICS manual mode set\n");

	printk("Setting AICS gain\n");
	expected_gain = g_aics_gain_max - 1;
	g_write_complete = g_cb = false;
	err = bt_vcs_aics_gain_set(g_conn, vcs.aics[0], expected_gain);
	if (err) {
		FAIL("Could not set AICS gain (err %d)\n", err);
		return err;
	}
	WAIT_FOR(g_aics_gain == expected_gain && g_cb && g_write_complete);
	printk("AICS gain set\n");

	printk("Setting AICS Description\n");
	strncpy(expected_aics_desc, "New Input Description",
		sizeof(expected_aics_desc));
	g_cb = false;
	err = bt_vcs_aics_description_set(g_conn, vcs.aics[0],
					  expected_aics_desc);
	if (err) {
		FAIL("Could not set AICS Description (err %d)\n", err);
		return err;
	}
	WAIT_FOR(!strncmp(expected_aics_desc, g_aics_desc,
			  sizeof(expected_aics_desc)) &&
		g_cb);
	printk("AICS Description set\n");

	printk("AICS passed\n");
	return 0;
}

static int test_vocs(void)
{
	int err;
	uint32_t expected_location;
	int16_t expected_offset;
	char expected_description[VOCS_DESC_SIZE];

	printk("Getting VOCS state\n");
	g_cb = false;
	err = bt_vcs_vocs_state_get(g_conn, vcs.vocs[0]);
	if (err) {
		FAIL("Could not get VOCS state (err %d)\n", err);
		return err;
	}
	WAIT_FOR(g_cb);
	printk("VOCS state get\n");

	printk("Getting VOCS location\n");
	g_cb = false;
	err = bt_vcs_vocs_location_get(g_conn, vcs.vocs[0]);
	if (err) {
		FAIL("Could not get VOCS location (err %d)\n", err);
		return err;
	}
	WAIT_FOR(g_cb);
	printk("VOCS location get\n");

	printk("Getting VOCS description\n");
	g_cb = false;
	err = bt_vcs_vocs_description_get(g_conn, vcs.vocs[0]);
	if (err) {
		FAIL("Could not get VOCS description (err %d)\n", err);
		return err;
	}
	WAIT_FOR(g_cb);
	printk("VOCS description get\n");

	printk("Setting VOCS location\n");
	expected_location = g_vocs_location + 1;
	g_cb = false;
	err = bt_vcs_vocs_location_set(g_conn, vcs.vocs[0], expected_location);
	if (err) {
		FAIL("Could not set VOCS location (err %d)\n", err);
		return err;
	}
	WAIT_FOR(g_vocs_location == expected_location && g_cb);
	printk("VOCS location set\n");

	printk("Setting VOCS state\n");
	expected_offset = g_vocs_offset + 1;
	g_write_complete = g_cb = false;
	err = bt_vcs_vocs_state_set(g_conn, vcs.vocs[0], expected_offset);
	if (err) {
		FAIL("Could not set VOCS state (err %d)\n", err);
		return err;
	}
	WAIT_FOR(g_vocs_offset == expected_offset && g_cb && g_write_complete);
	printk("VOCS state set\n");

	printk("Setting VOCS description\n");
	strncpy(expected_description, "New Output Description",
		sizeof(expected_description));
	g_cb = false;
	err = bt_vcs_vocs_description_set(g_conn, vcs.vocs[0],
					  expected_description);
	if (err) {
		FAIL("Could not set VOCS description (err %d)\n", err);
		return err;
	}
	WAIT_FOR(!strncmp(expected_description, g_vocs_desc,
			  sizeof(expected_description)) &&
		 g_cb);
	printk("VOCS description set\n");

	printk("VOCS passed\n");
	return 0;
}

static void test_main(void)
{
	int err;
	uint8_t expected_volume;
	uint8_t previous_volume;
	uint8_t expected_mute;
	static struct bt_gatt_exchange_params mtu_params =  {
		.func = mtu_cb,
	};

	err = bt_enable(bt_ready);

	if (err) {
		FAIL("Bluetooth discover failed (err %d)\n", err);
		return;
	}

	bt_conn_cb_register(&conn_callbacks);
	bt_vcs_client_cb_register(&vcs_cbs);

	WAIT_FOR(g_bt_init);

	err = bt_le_scan_start(BT_LE_SCAN_PASSIVE, device_found);
	if (err) {
		FAIL("Scanning failed to start (err %d)\n", err);
		return;
	}

	printk("Scanning successfully started\n");

	WAIT_FOR(g_is_connected);

	err = bt_gatt_exchange_mtu(g_conn, &mtu_params);
	if (err) {
		FAIL("Failed to exchange MTU %d", err);
	}

	WAIT_FOR(g_mtu_exchanged);

	err = bt_vcs_discover(g_conn);
	if (err) {
		FAIL("Failed to discover VCS %d", err);
	}

	WAIT_FOR(g_discovery_complete);

	err = bt_vcs_get(g_conn, &vcs);
	if (err) {
		FAIL("Failed to get VCS context (err %d)\n", err);
		return;
	}

	printk("Getting VCS volume state\n");
	g_cb = false;
	err = bt_vcs_volume_get(g_conn);
	if (err) {
		FAIL("Could not get VCS volume (err %d)\n", err);
		return;
	}
	WAIT_FOR(g_cb);
	printk("VCS volume get\n");

	printk("Getting VCS flags\n");
	g_cb = false;
	err = bt_vcs_flags_get(g_conn);
	if (err) {
		FAIL("Could not get VCS flags (err %d)\n", err);
		return;
	}
	WAIT_FOR(g_cb);
	printk("VCS flags get\n");

	expected_volume = g_volume != 100 ? 100 : 101; /* ensure change */
	g_write_complete = g_cb = false;
	err = bt_vcs_volume_set(g_conn, expected_volume);
	if (err) {
		FAIL("Could not set VCS volume (err %d)\n", err);
		return;
	}
	WAIT_FOR(g_volume == expected_volume && g_cb && g_write_complete);
	printk("VCS volume set\n");

	printk("Downing VCS volume\n");
	previous_volume = g_volume;
	g_write_complete = g_cb = false;
	err = bt_vcs_volume_down(g_conn);
	if (err) {
		FAIL("Could not get down VCS volume (err %d)\n", err);
		return;
	}
	WAIT_FOR(g_volume < previous_volume && g_cb && g_write_complete);
	printk("VCS volume downed\n");

	printk("Upping VCS volume\n");
	previous_volume = g_volume;
	g_write_complete = g_cb = false;
	err = bt_vcs_volume_up(g_conn);
	if (err) {
		FAIL("Could not up VCS volume (err %d)\n", err);
		return;
	}
	WAIT_FOR(g_volume > previous_volume && g_cb && g_write_complete);
	printk("VCS volume upped\n");

	printk("Muting VCS\n");
	expected_mute = 1;
	g_write_complete = g_cb = false;
	err = bt_vcs_mute(g_conn);
	if (err) {
		FAIL("Could not mute VCS (err %d)\n", err);
		return;
	}
	WAIT_FOR(g_mute == expected_mute && g_cb && g_write_complete);
	printk("VCS muted\n");

	printk("Downing and unmuting VCS\n");
	previous_volume = g_volume;
	expected_mute = 0;
	g_write_complete = g_cb = false;
	err = bt_vcs_unmute_volume_down(g_conn);
	if (err) {
		FAIL("Could not down and unmute VCS (err %d)\n", err);
		return;
	}
	WAIT_FOR(g_volume < previous_volume && expected_mute == g_mute &&
		 g_cb && g_write_complete);
	printk("VCS volume downed and unmuted\n");

	printk("Muting VCS\n");
	expected_mute = 1;
	g_write_complete = g_cb = false;
	err = bt_vcs_mute(g_conn);
	if (err) {
		FAIL("Could not mute VCS (err %d)\n", err);
		return;
	}
	WAIT_FOR(g_mute == expected_mute && g_cb && g_write_complete);
	printk("VCS muted\n");

	printk("Upping and unmuting VCS\n");
	previous_volume = g_volume;
	expected_mute = 0;
	g_write_complete = g_cb = false;
	err = bt_vcs_unmute_volume_up(g_conn);
	if (err) {
		FAIL("Could not up and unmute VCS (err %d)\n", err);
		return;
	}
	WAIT_FOR(g_volume > previous_volume && g_mute == expected_mute &&
		 g_cb && g_write_complete);
	printk("VCS volume upped and unmuted\n");

	printk("Muting VCS\n");
	expected_mute = 1;
	g_write_complete = g_cb = false;
	err = bt_vcs_mute(g_conn);
	if (err) {
		FAIL("Could not mute VCS (err %d)\n", err);
		return;
	}
	WAIT_FOR(g_mute == expected_mute && g_cb && g_write_complete);
	printk("VCS volume upped\n");

	printk("Unmuting VCS\n");
	expected_mute = 0;
	g_write_complete = g_cb = false;
	err = bt_vcs_unmute(g_conn);
	if (err) {
		FAIL("Could not unmute VCS (err %d)\n", err);
		return;
	}
	WAIT_FOR(g_mute == expected_mute && g_cb && g_write_complete);
	printk("VCS volume unmuted\n");

	if (CONFIG_BT_VCS_CLIENT_VOCS > 0) {
		if (test_vocs()) {
			return;
		}
	}

	if (CONFIG_BT_VCS_CLIENT_MAX_AICS_INST > 0) {
		if (test_aics()) {
			return;
		}
	}

	PASS("VCS client Passed");
}

static const struct bst_test_instance test_vcs[] = {
	{
		.test_id = "vcs_client",
		.test_post_init_f = test_init,
		.test_tick_f = test_tick,
		.test_main_f = test_main
	},
	BSTEST_END_MARKER
};

struct bst_test_list *test_vcs_client_install(struct bst_test_list *tests)
{
	return bst_add_tests(tests, test_vcs);
}

#else

struct bst_test_list *test_vcs_client_install(struct bst_test_list *tests)
{
	return tests;
}

#endif /* CONFIG_BT_VCS_CLIENT */
```
